## audioutils/tmptmp/tmptmp/tmptmp/fmsound/Kconfig
```kconfig
#
# For a description of the syntax of this configuration file,
# see the file kconfig-language.txt in the NuttX tools repository.
#

config AUDIOUTILS_FMSOUND_LIB
	bool "FM Sound Synthesizer Library"
	default n
	---help---
		Enable support for the FM Sound Synthesizer library.
```

## examples/fmsynth_keyboard/Kconfig
```kconfig
#
# For a description of the syntax of this configuration file,
# see the file kconfig-language.txt in the NuttX tools repository.
#

config EXAMPLES_FMSYNTH_KEYBOARD
	tristate "Simple FM Synthesizer music keyboard"
	default n
	---help---
		Sample program of a simple FM Synthesizer keyboard.

if EXAMPLES_FMSYNTH_KEYBOARD

config EXAMPLES_FMSYNTH_KEYBOARD_PROGNAME
	string "Simple music keyboard Program name"
	default "keyboard"
	---help---
		Command name of this "Simple music keyboard".

config EXAMPLES_FMSYNTH_KEYBOARD_PRIORITY
	int "Simple music keyboard task priority"
	default 100

config EXAMPLES_FMSYNTH_KEYBOARD_STACKSIZE
	int "Simple music keyboard stack size"
	default 2048

endif
```

## examples/simple_nxaudio/Kconfig
```kconfig
#
# For a description of the syntax of this configuration file,
# see the file kconfig-language.txt in the NuttX tools repository.
#

config EXAMPLES_SIMPLE_NXAUDIO
	tristate "Simple NX Audio"
	default n
	---help---
		Sample NX Audio sample
```

## tttttt/fmsynth/Kconfig
```kconfig
#
# For a description of the syntax of this configuration file,
# see the file kconfig-language.txt in the NuttX tools repository.
#

config EXAMPLES_FMSYNTH
	bool "FM Synthesizer Samples"
	default n
	---help---
		Enable sample programs of fmsynth library.

if EXAMPLES_FMSYNTH

menu "FM Synthesizer Samples"

config EXAMPLES_FMSYNTH_MMLPLAYER
	tristate "MML player with FM Synthesizer"
	default y
	---help---
		Sample program of play music according to "Music Macro Language"

if EXAMPLES_FMSYNTH_MMLPLAYER

config EXAMPLES_FMSYNTH_MMLPLAYER_PROGNAME
	string "FM Synthesizer MML Player Program name"
	default "mmlplayer"
	---help---
		Command name of this "FM Synthesizer MML Player" on NuttShell command prompt.

config EXAMPLES_FMSYNTH_MMLPLAYER_PRIORITY
	int "FM Synthesizer MML Player task priority"
	default 100

config EXAMPLES_FMSYNTH_MMLPLAYER_STACKSIZE
	int "FM Synthesizer MML Player stack size"
	default 2048

endif

config EXAMPLES_FMSYNTH_KEYBOARD
	tristate "FM Synthesizer simple FM Synthesizer keyboard"
	default y
	---help---
		Sample program of a simple FM Synthesizer keyboard.

if EXAMPLES_FMSYNTH_KEYBOARD

config EXAMPLES_FMSYNTH_KEYBOARD_PROGNAME
	string "FM Synthesizer simple music keyboard Program name"
	default "musickeyboard"
	---help---
		Command name of this "FM Synthesizer simple music keyboard" on NuttShell command prompt.

config EXAMPLES_FMSYNTH_KEYBOARD_PRIORITY
	int "FM Synthesizer simple music keyboard task priority"
	default 100

config EXAMPLES_FMSYNTH_KEYBOARD_STACKSIZE
	int "FM Synthesizer simple music keyboard stack size"
	default 2048

endif

endmenu

endif
```

## tttttt/fmsynth_mmlplayer/Kconfig
```kconfig
#
# For a description of the syntax of this configuration file,
# see the file kconfig-language.txt in the NuttX tools repository.
#

config EXAMPLES_FMSYNTH_MMLPLAYER
	tristate "MML player of FM Synthesizer"
	default n
	---help---
		Sample program of play music according to "Music Macro Language"
		with FM Synthesizer sound.

if EXAMPLES_FMSYNTH_MMLPLAYER

config EXAMPLES_FMSYNTH_MMLPLAYER_PROGNAME
	string "FM Synthesizer MML Player Program name"
	default "mmlplayer"
	---help---
		Command name of this "FM Synthesizer MML Player".

config EXAMPLES_FMSYNTH_MMLPLAYER_PRIORITY
	int "FM Synthesizer MML Player task priority"
	default 100

config EXAMPLES_FMSYNTH_MMLPLAYER_STACKSIZE
	int "FM Synthesizer MML Player stack size"
	default 2048

endif
```
